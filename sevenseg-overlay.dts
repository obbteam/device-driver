/dts-v1/;
/plugin/;

/ {                            /* <-- include line removed entirely */
        compatible = "brcm,bcm2835";

        fragment@0 {
                target-path = "/";

                __overlay__ {
                        sevenseg: sevenseg@0 {
                                compatible = "akhmadkhonov,sevenseg";

                                seg-gpios = <
                                        &gpio  5 0
                                        &gpio  6 0
                                        &gpio  4 0
                                        &gpio 17 0
                                        &gpio 27 0
                                        &gpio 22 0
                                        &gpio 10 0
                                        &gpio  9 0
                                >;
                        };
                };
        };
};
